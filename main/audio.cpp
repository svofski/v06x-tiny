#define CLEAN_BEEP_TEST 0

#include <cstdint>
#include "esp_attr.h"
#include "esp_log.h"
#include "freertos/FreeRTOS.h"

#include "params.h"
#include "audio.h"
#include "sync.h"
#if WITH_I2S_AUDIO
#include "driver/i2s_std.h"
#include "driver/gpio.h"
#endif

#include "AySound.h"
#include "esp_filler.h"

static inline uint32_t getccount()
{
    uint32_t ccount;
    asm volatile("rsr.ccount %0" : "=a"(ccount));
    return ccount;
}

namespace audio
{

audio_sample_t * audio_pp[AUDIO_NBUFFERS];
uint8_t * ay_pp[AUDIO_NBUFFERS];

audio_sample_t audio_copy[AUDIO_SAMPLES_PER_FRAME];

i2s_chan_handle_t tx_handle;
bool i2s_ready;

#if WITH_I2S_AUDIO
IRAM_ATTR
void audio_task(void *unused)
{
    /* Get the default channel configuration by the helper macro.
    * This helper macro is defined in `i2s_common.h` and shared by all the I2S communication modes.
    * It can help to specify the I2S role and port ID */
    i2s_chan_config_t chan_cfg = I2S_CHANNEL_DEFAULT_CONFIG(I2S_NUM_AUTO, I2S_ROLE_MASTER);
    chan_cfg.dma_desc_num = 2;
    chan_cfg.dma_frame_num = 624;

    /* Allocate a new TX channel and get the handle of this channel */
    ESP_ERROR_CHECK(i2s_new_channel(&chan_cfg, &tx_handle, NULL));

    /* Setting the configurations, the slot configuration and clock configuration can be generated by the macros
    * These two helper macros are defined in `i2s_std.h` which can only be used in STD mode.
    * They can help to specify the slot and clock configurations for initialization or updating */
    i2s_std_config_t std_cfg = {
        .clk_cfg = I2S_STD_CLK_DEFAULT_CONFIG(AUDIO_SAMPLERATE),
        .slot_cfg = I2S_STD_MSB_SLOT_DEFAULT_CONFIG(I2S_DATA_BIT_WIDTH_16BIT, I2S_SLOT_MODE_MONO),
        .gpio_cfg = {
            .mclk = I2S_GPIO_UNUSED,
            .bclk = (gpio_num_t)I2S_BCLK,
            .ws = (gpio_num_t)I2S_LRC,
            .dout = (gpio_num_t)I2S_DOUT,
            .din = I2S_GPIO_UNUSED,
            .invert_flags = {
                .mclk_inv = false,
                .bclk_inv = false,
                .ws_inv = false,
            },
        },
    };
    /* Initialize the channel */
    ESP_ERROR_CHECK(i2s_channel_init_std_mode(tx_handle, &std_cfg));

    /* Before writing data, start the TX channel first */
    ESP_ERROR_CHECK(i2s_channel_enable(tx_handle));
    ESP_LOGI(TAG, "Created I2S channel and started audio task");
#if I2S_NOQUEUE
    i2s_ready = true;
    while(1) vTaskDelay(pdMS_TO_TICKS(1000));
#else
    while(1) {
        audio_queue_item_t aqi;
        size_t written;
        BaseType_t result = xQueueReceive(audio_queue, &aqi, portMAX_DELAY);
        if (result == pdTRUE) {
            //AySound::gen_sound(AUDIO_SAMPLES_PER_FRAME - aqi.ay_bufpos, aqi.ay_bufpos);
            for (size_t i = 0; i < AUDIO_SAMPLES_PER_FRAME; ++i) {
                audio_pp[aqi.audiobuf_index][i] += ay_pp[aqi.audiobuf_index][i] << AUDIO_SCALE_AY;
                //printf("%d ", audio_pp[aqi.audiobuf_index][i]);
            }
            #if CLEAN_BEEP_TEST
            for (int i = 0; i < AUDIO_SAMPLES_PER_FRAME; ++i) {
                audio_pp[aqi.audiobuf_index][i] = ((i / 12) & 1) << 7; //13;
            }
            #endif
        }
        else {
            printf("audio: starved!");
        }
        //uint32_t start = getccount();
        i2s_channel_write(tx_handle, audio_pp[aqi.audiobuf_index], AUDIO_SAMPLES_PER_FRAME * AUDIO_SAMPLE_SIZE, &written, 50 / portTICK_PERIOD_MS);
        //uint32_t elapsed = getccount() - start;
        //printf("\n\n");
        // test if buffer is usable after channel write (yes)
        //memset(audio_pp[aqi.audiobuf_index], 0, AUDIO_SAMPLES_PER_FRAME * AUDIO_SAMPLE_SIZE);
        //printf("audio: buf %d -> %u\n", aqi.audiobuf_index, written);
        //printf("ay: falta %d samps\n", AUDIO_SAMPLES_PER_FRAME - aqi.ay_bufpos);
        //if (elapsed >= 4800000) 
        //printf("audio: cc=%lu  %d %d %d %d\n", elapsed, 
        //        audio_pp[aqi.audiobuf_index][0],
        //        audio_pp[aqi.audiobuf_index][1],
        //        audio_pp[aqi.audiobuf_index][2],
        //        audio_pp[aqi.audiobuf_index][3]
        //        );
    }
#endif
}
#endif

void allocate_buffers()
{
    for (int i = 0; i < AUDIO_NBUFFERS; ++i) {
        audio_pp[i] = static_cast<audio_sample_t *>(heap_caps_malloc(AUDIO_SAMPLES_PER_FRAME * AUDIO_SAMPLE_SIZE, MALLOC_CAP_INTERNAL));
        assert(audio_pp[i]);

        ay_pp[i] = static_cast<uint8_t *>(heap_caps_malloc(AUDIO_SAMPLES_PER_FRAME, MALLOC_CAP_INTERNAL));
        assert(ay_pp[i]);
    }
}

void create_pinned_to_core()
{
    xTaskCreatePinnedToCore(&audio_task, "audio task", 1024*4, NULL, AUDIO_PRIORITY, NULL, AUDIO_CORE);
}

}
